## source/kernel/device/disk/Kconfig
```kconfig
#
# SPDX-FileCopyrightText: (C) Alex Smith <alex@alex-smith.me.uk>
# SPDX-License-Identifier: ISC
#

comment "Disk devices"

# Selected by ATA device drivers if enabled.
config DEVICE_DISK_ATA
	bool

config DEVICE_DISK_PCI_ATA
	bool "PCI ATA controller driver"
	default y
	select DEVICE_DISK_ATA
	depends on DEVICE_BUS_PCI
	help
	  Enable the PCI ATA controller driver. This supports PATA (IDE)
	  controllers, and SATA controllers in IDE emulation mode.
```

## source/kernel/device/input/Kconfig
```kconfig
#
# SPDX-FileCopyrightText: (C) Alex Smith <alex@alex-smith.me.uk>
# SPDX-License-Identifier: ISC
#

comment "Input devices"

config DEVICE_INPUT_I8042
	bool "i8042 keyboard/mouse port"
	default y
	depends on ARCH_X86
	help
	  Enable the i8042 (PS/2) keyboard/mouse port driver.
```

## source/kernel/device/irq/Kconfig
```kconfig
#
# SPDX-FileCopyrightText: (C) Alex Smith <alex@alex-smith.me.uk>
# SPDX-License-Identifier: ISC
#

comment "IRQ controllers"

config DEVICE_IRQ_ARM_GIC_V2
	bool "ARM GIC v2 IRQ controller"
	default y
	depends on DEVICE_BUS_DT && ARCH_ARM64
	help
	  Enable the driver for the ARM GIC v2 IRQ controller.

config DEVICE_IRQ_BCM2836_L1
	bool "BCM2836 L1 IRQ controller"
	default y
	depends on DEVICE_BUS_DT && ARCH_ARM64
	help
	  Enable the driver for the root IRQ controller on the Raspberry Pi 2+.
```

## source/kernel/device/net/Kconfig
```kconfig
#
# SPDX-FileCopyrightText: (C) Alex Smith <alex@alex-smith.me.uk>
# SPDX-License-Identifier: ISC
#

comment "Network devices"

config DEVICE_NET_VIRTIO_NET
	bool "VirtIO network device"
	default y
    depends on DEVICE_BUS_VIRTIO
	help
	  Enable support for VirtIO network devices implemented by virtual machines
	  such as QEMU and VirtualBox.
```

## source/kernel/device/timer/Kconfig
```kconfig
#
# SPDX-FileCopyrightText: (C) Alex Smith <alex@alex-smith.me.uk>
# SPDX-License-Identifier: ISC
#

comment "Timer devices"

config DEVICE_TIMER_ARM
	bool "ARM Generic Timer"
	default y
	depends on DEVICE_BUS_DT && ARCH_ARM64
	help
	  Enable the driver for the ARM Generic Timer defined in the ARMv7/8
	  architectures.
```

## source/kernel/io/fs/Kconfig
```kconfig
#
# SPDX-FileCopyrightText: (C) Alex Smith <alex@alex-smith.me.uk>
# SPDX-License-Identifier: ISC
#

menu "Filesystem support"

config FS_EXT2
	bool "Ext2/3/4 filesystem support"
	default y
	help
	  Enable support for Ext2/3/4 filesystems.

endmenu
```

## source/kernel/modules/Kconfig
```kconfig
#
# Copyright (C) 2010 Alex Smith
#
# Permission to use, copy, modify, and/or distribute this software for any
# purpose with or without fee is hereby granted, provided that the above
# copyright notice and this permission notice appear in all copies.
#
# THE SOFTWARE IS PROVIDED AS IS AND THE AUTHOR DISCLAIMS ALL WARRANTIES
# WITH REGARD TO THIS SOFTWARE INCLUDING ALL IMPLIED WARRANTIES OF
# MERCHANTABILITY AND FITNESS. IN NO EVENT SHALL THE AUTHOR BE LIABLE FOR
# ANY SPECIAL, DIRECT, INDIRECT, OR CONSEQUENTIAL DAMAGES OR ANY DAMAGES
# WHATSOEVER RESULTING FROM LOSS OF USE, DATA OR PROFITS, WHETHER IN AN
# ACTION OF CONTRACT, NEGLIGENCE OR OTHER TORTIOUS ACTION, ARISING OUT OF
# OR IN CONNECTION WITH THE USE OR PERFORMANCE OF THIS SOFTWARE.
#

##############
menu "Modules"
##############

comment "Filesystem modules"

config MODULE_FS_EXT2
	bool "Ext2 filesystem module"
	default y
	help
	  Enable the Ext2 filesystem module.

config MODULE_FS_EXT2_DEBUG
	bool "Ext2 module debug output"
	default n
	depends on DEBUG && MODULE_FS_EXT2
	help
	  Enable verbose debugging output from the Ext2 filesystem module.

comment "Platform-specific modules"

config MODULE_PLATFORM_BIOS
	bool "PC BIOS interrupt interface"
	default y
	depends on PLATFORM_PC
	help
	  Enable the PC BIOS interrupt interface module which allows other
	  modules to make calls to real-mode BIOS interrupts.

#######
endmenu
#######
```

## source/kernel/platform/pc/Kconfig
```kconfig
# Copyright (C) 2010 Alex Smith
#
# Kiwi is open source software, released under the terms of the Non-Profit
# Open Software License 3.0. You should have received a copy of the
# licensing information along with the source code distribution. If you
# have not received a copy of the license, please refer to the Kiwi
# project website.
#
# Please note that if you modify this file, the license requires you to
# ADD your name to the list of contributors. This boilerplate is not the
# license itself; please refer to the copy of the license you have received
# for complete terms.

choice
	prompt "Serial port"
	default PC_SERIAL_PORT_COM1
	help
	  Which serial port to use for kernel console output.

config PC_SERIAL_PORT_DISABLED
	bool "Disabled"

config PC_SERIAL_PORT_COM1
	bool "COM1"

config PC_SERIAL_PORT_COM2
	bool "COM2"

config PC_SERIAL_PORT_COM3
	bool "COM3"

config PC_SERIAL_PORT_COM4
	bool "COM4"

endchoice

config PC_SERIAL_PORT
	int
	default 0 if PC_SERIAL_PORT_DISABLED
	default 1 if PC_SERIAL_PORT_COM1
	default 2 if PC_SERIAL_PORT_COM2
	default 3 if PC_SERIAL_PORT_COM3
	default 4 if PC_SERIAL_PORT_COM4
```
