## Kconfig
```kconfig
#
# Copyright (C) 2009-2022 Alex Smith
#
# Permission to use, copy, modify, and/or distribute this software for any
# purpose with or without fee is hereby granted, provided that the above
# copyright notice and this permission notice appear in all copies.
#
# THE SOFTWARE IS PROVIDED "AS IS" AND THE AUTHOR DISCLAIMS ALL WARRANTIES
# WITH REGARD TO THIS SOFTWARE INCLUDING ALL IMPLIED WARRANTIES OF
# MERCHANTABILITY AND FITNESS. IN NO EVENT SHALL THE AUTHOR BE LIABLE FOR
# ANY SPECIAL, DIRECT, INDIRECT, OR CONSEQUENTIAL DAMAGES OR ANY DAMAGES
# WHATSOEVER RESULTING FROM LOSS OF USE, DATA OR PROFITS, WHETHER IN AN
# ACTION OF CONTRACT, NEGLIGENCE OR OTHER TORTIOUS ACTION, ARISING OUT OF
# OR IN CONNECTION WITH THE USE OR PERFORMANCE OF THIS SOFTWARE.
#

mainmenu "Kiwi Configuration"

config KERNELVERSION
	string
	option env="KERNELVERSION"

config DEBUG
	bool

choice
	prompt "Build type"
	default BUILD_DEBUGOPT

config BUILD_DEBUG
	bool "debug"
	select DEBUG
	help
	  Build without optimization, and enable various sections of debugging code
	  and extra checks. For the kernel, this enables assertions and messages
	  with the LOG_DEBUG log level. It also disables the boot splash screen by
	  default.
	  
	  The built system will generally be very slow, so don't use it unless you
	  really need it.

config BUILD_DEBUGOPT
	bool "debugopt"
	select DEBUG
	help
	  Like debug, but enables compiler optimization.
	  
	  The built system will be slower than release due to assertions and
	  additional debugging checks, but much better than debug. This is the
	  typical configuration for development.

config BUILD_RELEASE
	bool "release"
	help
	  This builds a standard, optimized system, without kernel assertions or
	  extra debugging code.

endchoice

config BUILD
	string
	default "debug" if BUILD_DEBUG
	default "debugopt" if BUILD_DEBUGOPT
	default "release" if BUILD_RELEASE

####################
menu "Build options"
####################

config TOOLCHAIN_DIR
	string "Toolchain directory"
	default "/please/change/me"
	help
	  Path to directory to store toolchain downloads and builds in.

config TOOLCHAIN_MAKE_JOBS
	int "Toolchain parallel build jobs"
	default 1
	help
	  Argument to pass to -j for make when building the toolchain.

config EXTRA_CCFLAGS
	string "Extra CCFLAGS"
	default ""
	help
	  Extra compiler options for both C and C++ code.

config EXTRA_CFLAGS
	string "Extra CFLAGS"
	default ""
	help
	  Extra compiler options for C code.

config EXTRA_CXXFLAGS
	string "Extra CXXFLAGS"
	default ""
	help
	  Extra compiler options for C++ code.

config QEMU_BINARY_AMD64
	string "QEMU binary"
	depends on ARCH_AMD64
	default "qemu-system-x86_64"
	help
	  Path to the QEMU binary to use for the "qemu" build target.

config QEMU_BINARY_ARM64
	string "QEMU binary"
	depends on ARCH_ARM64
	default "qemu-system-aarch64"
	help
	  Path to the QEMU binary to use for the "qemu" build target.

config QEMU_OPTS_AMD64
	string "Extra QEMU options"
	depends on ARCH_AMD64
	default "-monitor vc:1024x768 -serial stdio -vga std -s -rtc base=localtime -m 1024 -enable-kvm -smp cpus=4,cores=4 -nic user,model=virtio-net-pci"
	help
	  Extra options to pass to QEMU for the "qemu" build target.

config QEMU_OPTS_ARM64
	string "Extra QEMU options"
	depends on ARCH_ARM64
	default "-monitor vc:1024x768 -serial stdio -s -m 1024 -M virt -cpu cortex-a72"
	help
	  Extra options to pass to QEMU for the "qemu" build target.

config FORCE_VIDEO_MODE
	string "Force a video mode to be used"
	default ""
	help
	  If set, the boot loader configuration file will be generated with the
	  video_mode option set to this value.

#######
endmenu
#######

#######################
comment "Target system"
#######################

config 32BIT
	bool

config 64BIT
	bool

config SYS_SUPPORTS_LITTLE_ENDIAN
	bool

config SYS_SUPPORTS_BIG_ENDIAN
	bool

# Flag which can be used to disable userspace build while bringing up a new
# platform.
config SYS_SUPPORTS_USERSPACE
	bool

# For KBoot compatibility.
config ARCH_X86
	bool

choice
	prompt "Architecture"
	default ARCH_AMD64

config ARCH_AMD64
	bool "AMD64"
	select 64BIT
	select ARCH_X86
	select SYS_SUPPORTS_LITTLE_ENDIAN
	select SYS_SUPPORTS_USERSPACE
	help
	  Target the built system to 64-bit x86 PCs.

config ARCH_ARM64
	bool "ARM64"
	select 64BIT
	select SYS_SUPPORTS_LITTLE_ENDIAN
	help
	  Target the built system to 64-bit ARM processors.

endchoice

config ARCH
	string
	default "amd64" if ARCH_AMD64
	default "arm64" if ARCH_ARM64

config GDB_ARCH
	string
	default "i386:x86-64:intel" if ARCH_AMD64
	default "aarch64" if ARCH_ARM64

config TOOLCHAIN_TARGET
	string
	default "x86_64-kiwi" if ARCH_AMD64
	default "aarch64-kiwi" if ARCH_ARM64

config TOOLCHAIN_ARCH
	string
	default "x86_64" if ARCH_AMD64
	default "aarch64" if ARCH_ARM64

config ARCH_ASFLAGS
	string
	default ""

config ARCH_CCFLAGS
	string
	default ""

config KBOOT_TARGETS
	string
	default "bios,efi-amd64,efi-ia32" if ARCH_AMD64
	default "dt-arm64" if ARCH_ARM64

choice
	prompt "Endianness"
	default LITTLE_ENDIAN

config BIG_ENDIAN
	bool "Big endian"
	depends on SYS_SUPPORTS_BIG_ENDIAN

config LITTLE_ENDIAN
	bool "Little endian"
	depends on SYS_SUPPORTS_LITTLE_ENDIAN

endchoice

##############################
comment "System configuration"
##############################

menu "Kernel configuration"
source "source/kernel/Kconfig"
endmenu
```

## config/Kconfig.arch
```kconfig
#
# Copyright (C) 2009-2022 Alex Smith
#
# Permission to use, copy, modify, and/or distribute this software for any
# purpose with or without fee is hereby granted, provided that the above
# copyright notice and this permission notice appear in all copies.
#
# THE SOFTWARE IS PROVIDED "AS IS" AND THE AUTHOR DISCLAIMS ALL WARRANTIES
# WITH REGARD TO THIS SOFTWARE INCLUDING ALL IMPLIED WARRANTIES OF
# MERCHANTABILITY AND FITNESS. IN NO EVENT SHALL THE AUTHOR BE LIABLE FOR
# ANY SPECIAL, DIRECT, INDIRECT, OR CONSEQUENTIAL DAMAGES OR ANY DAMAGES
# WHATSOEVER RESULTING FROM LOSS OF USE, DATA OR PROFITS, WHETHER IN AN
# ACTION OF CONTRACT, NEGLIGENCE OR OTHER TORTIOUS ACTION, ARISING OUT OF
# OR IN CONNECTION WITH THE USE OR PERFORMANCE OF THIS SOFTWARE.
#

config 32BIT
	bool

config 64BIT
	bool

config SYS_SUPPORTS_LITTLE_ENDIAN
	bool

config SYS_SUPPORTS_BIG_ENDIAN
	bool

# Flag which can be used to disable userspace build while bringing up a new
# platform.
config SYS_SUPPORTS_USERSPACE
	bool

# For KBoot compatibility.
config ARCH_X86
	bool

choice
	prompt "Architecture"
	default ARCH_AMD64

config ARCH_AMD64
	bool "AMD64"
	select 64BIT
	select ARCH_X86
	select SYS_SUPPORTS_LITTLE_ENDIAN
	select SYS_SUPPORTS_USERSPACE
	help
	  Target the built system to 64-bit x86 PCs.

config ARCH_ARM64
	bool "ARM64"
	select 64BIT
	select SYS_SUPPORTS_LITTLE_ENDIAN
	help
	  Target the built system to 64-bit ARM processors.

endchoice

config ARCH
	string
	default "amd64" if ARCH_AMD64
	default "arm64" if ARCH_ARM64

config GDB_ARCH
	string
	default "i386:x86-64:intel" if ARCH_AMD64
	default "aarch64" if ARCH_ARM64

config TOOLCHAIN_TARGET
	string
	default "x86_64-kiwi" if ARCH_AMD64
	default "aarch64-kiwi" if ARCH_ARM64

config TOOLCHAIN_ARCH
	string
	default "x86_64" if ARCH_AMD64
	default "aarch64" if ARCH_ARM64

config ARCH_ASFLAGS
	string
	default ""

config ARCH_CCFLAGS
	string
	default ""

config KBOOT_TARGETS
	string
	default "bios,efi-amd64,efi-ia32" if ARCH_AMD64
	default "dt-arm64" if ARCH_ARM64

choice
	prompt "Endianness"
	default LITTLE_ENDIAN

config BIG_ENDIAN
	bool "Big endian"
	depends on SYS_SUPPORTS_BIG_ENDIAN

config LITTLE_ENDIAN
	bool "Little endian"
	depends on SYS_SUPPORTS_LITTLE_ENDIAN

endchoice
```

## config/Kconfig.platform
```kconfig
#
# Copyright (C) 2009-2021 Alex Smith
#
# Permission to use, copy, modify, and/or distribute this software for any
# purpose with or without fee is hereby granted, provided that the above
# copyright notice and this permission notice appear in all copies.
#
# THE SOFTWARE IS PROVIDED "AS IS" AND THE AUTHOR DISCLAIMS ALL WARRANTIES
# WITH REGARD TO THIS SOFTWARE INCLUDING ALL IMPLIED WARRANTIES OF
# MERCHANTABILITY AND FITNESS. IN NO EVENT SHALL THE AUTHOR BE LIABLE FOR
# ANY SPECIAL, DIRECT, INDIRECT, OR CONSEQUENTIAL DAMAGES OR ANY DAMAGES
# WHATSOEVER RESULTING FROM LOSS OF USE, DATA OR PROFITS, WHETHER IN AN
# ACTION OF CONTRACT, NEGLIGENCE OR OTHER TORTIOUS ACTION, ARISING OUT OF
# OR IN CONNECTION WITH THE USE OR PERFORMANCE OF THIS SOFTWARE.
#

choice
	prompt "Platform"
	default PLATFORM_PC if ARCH_X86
	default PLATFORM_DT if ARCH_ARM64

config PLATFORM_DT
	bool "Device Tree"
	depends on ARCH_ARM64
	help
	  Generic platform which uses a Device Tree to describe the hardware.
	  This platform currently supports the following ARM64 hardware:
	   - Raspberry Pi 4

config PLATFORM_PC
	bool "Standard PC"
	depends on ARCH_X86
	help
	  Target the built system to standard PCs (nearly all x86 computers).

endchoice

config PLATFORM
	string
	default "pc" if PLATFORM_PC
	default "dt" if PLATFORM_DT

config KBOOT_TARGETS
	string
	default "bios,efi-amd64,efi-ia32" if PLATFORM_PC
	default "dt-arm64" if PLATFORM_DT
```

## source/drivers/Kconfig
```kconfig
#
# Copyright (C) 2010 Alex Smith
#
# Permission to use, copy, modify, and/or distribute this software for any
# purpose with or without fee is hereby granted, provided that the above
# copyright notice and this permission notice appear in all copies.
#
# THE SOFTWARE IS PROVIDED AS IS AND THE AUTHOR DISCLAIMS ALL WARRANTIES
# WITH REGARD TO THIS SOFTWARE INCLUDING ALL IMPLIED WARRANTIES OF
# MERCHANTABILITY AND FITNESS. IN NO EVENT SHALL THE AUTHOR BE LIABLE FOR
# ANY SPECIAL, DIRECT, INDIRECT, OR CONSEQUENTIAL DAMAGES OR ANY DAMAGES
# WHATSOEVER RESULTING FROM LOSS OF USE, DATA OR PROFITS, WHETHER IN AN
# ACTION OF CONTRACT, NEGLIGENCE OR OTHER TORTIOUS ACTION, ARISING OUT OF
# OR IN CONNECTION WITH THE USE OR PERFORMANCE OF THIS SOFTWARE.
#

##############
menu "Drivers"
##############

comment "Bus managers"

config DRIVER_BUS_ATA
	bool "ATA bus manager"
	default y
	help
	  Enable the ATA bus manager. Note that this is not the actual ATA
	  device driver, it is a generic library used by ATA drivers. You will
	  need to enable the driver for your ATA device.

config DRIVER_BUS_PCI
	bool "PCI bus manager"
	default y
	help
	  Enable the PCI bus manager driver.

comment "Disk devices"

config DRIVER_DISK_AHCI
	bool "AHCI controller driver"
	default y
	depends on DRIVER_BUS_ATA && DRIVER_BUS_PCI
	help
	  Enable the AHCI SATA controller driver.
	
config DRIVER_DISK_PCI_ATA
	bool "PCI ATA controller driver"
	default y
	depends on DRIVER_BUS_ATA && DRIVER_BUS_PCI
	help
	  Enable the PCI ATA controller driver. This supports PATA (IDE)
	  controllers, and SATA controllers in IDE emulation mode.

comment "Display devices"

config DRIVER_DISPLAY_VBE
	bool "VBE display device driver"
	default y
	depends on MODULE_PLATFORM_BIOS
	help
	  Enable the VBE display device driver.

comment "Input devices"

config DRIVER_INPUT_I8042
	bool "i8042 keyboard/mouse port driver"
	default y
	depends on PLATFORM_PC
 	help
	  Enable the i8042 (PS/2) keyboard/mouse port driver.

#######
endmenu
#######
```

## source/kernel/Kconfig
```kconfig
#
# SPDX-FileCopyrightText: (C) Alex Smith <alex@alex-smith.me.uk>
# SPDX-License-Identifier: ISC
#

config KLOG_SIZE
	int "Kernel log buffer size"
	default 16384
	help
	  Size for the kernel log buffer (in characters).

menu "Architecture"
source "arch/Kconfig"
endmenu

########################
menu "Debugging options"
	depends on DEBUG
########################

config KMEM_TRACING
	bool "Kmem allocation tracing"
	default n
	help
	  Enable output on the debug console on every kmem allocation/free,
	  to run through utilities/alloc_stats.py.

config PAGE_TRACING
	bool "Page allocation tracing"
	default n
	help
	  Enable output on the debug console on every page allocation/free,
	  to run through utilities/alloc_stats.py.

config SLAB_STATS
	bool "Slab allocator statistics"
	default n
	help
	  Enable extra statistics in the slab allocator. This is not enabled by
	  default as it causes a slight performance hit.

config SLAB_TRACING
	bool "Slab allocation tracing"
	default n
	help
	  Enable output on the debug console on every slab allocation/free,
	  to run through utilities/alloc_stats.py.

config SLAB_GUARD
	bool "Slab allocation overrun guard"
	default n
	help
	  Guard the end of each slab allocation with a magic value that will
	  detect buffer overruns when freed.

#######
endmenu
#######

source "device/Kconfig"
source "io/fs/Kconfig"
```

## source/kernel/arch/Kconfig
```kconfig
#
# SPDX-FileCopyrightText: (C) Alex Smith <alex@alex-smith.me.uk>
# SPDX-License-Identifier: ISC
#

if ARCH_AMD64
source "amd64/Kconfig"
endif

if ARCH_ARM64
source "arm64/Kconfig"
endif
```

## source/kernel/arch/amd64/Kconfig
```kconfig
#
# SPDX-FileCopyrightText: (C) Alex Smith <alex@alex-smith.me.uk>
# SPDX-License-Identifier: ISC
#

config KERNEL_ARCH_AMD64
	def_bool y
```

## source/kernel/arch/arm64/Kconfig
```kconfig
#
# SPDX-FileCopyrightText: (C) Alex Smith <alex@alex-smith.me.uk>
# SPDX-License-Identifier: ISC
#

config KERNEL_ARCH_ARM64
	def_bool y
	select DEVICE_BUS_DT
```

## source/kernel/arch/x86/Kconfig
```kconfig
#
# Copyright (C) 2010 Alex Smith
#
# Permission to use, copy, modify, and/or distribute this software for any
# purpose with or without fee is hereby granted, provided that the above
# copyright notice and this permission notice appear in all copies.
#
# THE SOFTWARE IS PROVIDED AS IS AND THE AUTHOR DISCLAIMS ALL WARRANTIES
# WITH REGARD TO THIS SOFTWARE INCLUDING ALL IMPLIED WARRANTIES OF
# MERCHANTABILITY AND FITNESS. IN NO EVENT SHALL THE AUTHOR BE LIABLE FOR
# ANY SPECIAL, DIRECT, INDIRECT, OR CONSEQUENTIAL DAMAGES OR ANY DAMAGES
# WHATSOEVER RESULTING FROM LOSS OF USE, DATA OR PROFITS, WHETHER IN AN
# ACTION OF CONTRACT, NEGLIGENCE OR OTHER TORTIOUS ACTION, ARISING OUT OF
# OR IN CONNECTION WITH THE USE OR PERFORMANCE OF THIS SOFTWARE.
#

config SRCARCH
	string
	default "x86"

config TOOLCHAIN_TARGET
	string
	default "x86_64-kiwi" if ARCH_AMD64
	default "i686-kiwi" if ARCH_IA32

config ARCH_X86
	def_bool y

config ARCH_32BIT
	def_bool ARCH_IA32

config ARCH_64BIT
	def_bool ARCH_AMD64

config ARCH_LITTLE_ENDIAN
	def_bool y

config X86_NX
	bool "No-Execute (NX) support"
	default y
	help
	  Enable support for the No-Execute/Execute-Disable bit supported by
	  recent CPUs.
```

## source/kernel/device/Kconfig
```kconfig
#
# SPDX-FileCopyrightText: (C) Alex Smith <alex@alex-smith.me.uk>
# SPDX-License-Identifier: ISC
#

menu "Device support"

source "bus/Kconfig"
source "console/Kconfig"
source "disk/Kconfig"
source "input/Kconfig"
source "irq/Kconfig"
source "net/Kconfig"
source "timer/Kconfig"

endmenu
```

## source/kernel/device/bus/Kconfig
```kconfig
#
# SPDX-FileCopyrightText: (C) Alex Smith <alex@alex-smith.me.uk>
# SPDX-License-Identifier: ISC
#

comment "Bus managers"

# Selected by architecture if required.
config DEVICE_BUS_DT
	bool

config DEVICE_BUS_PCI
	bool "PCI bus manager"
	default y
	depends on ARCH_X86
	help
	  Enable the PCI bus manager.

config DEVICE_BUS_VIRTIO
	bool "VirtIO bus manager"
	default y
	help
	  Enable support for VirtIO devices. This is just the core VirtIO bus
	  manager - to be useful, a transport driver and device drivers must also
	  be enabled.

config DEVICE_BUS_VIRTIO_PCI
	bool "VirtIO PCI transport driver"
	default y
	depends on DEVICE_BUS_PCI && DEVICE_BUS_VIRTIO
	help
	  Enable support for VirtIO over PCI.
```

## source/kernel/device/console/Kconfig
```kconfig
#
# SPDX-FileCopyrightText: (C) Alex Smith <alex@alex-smith.me.uk>
# SPDX-License-Identifier: ISC
#

config DEVICE_CONSOLE_NS16550
	depends on ARCH_ARM64 || ARCH_X86
    def_bool y

config DEVICE_CONSOLE_PL011
	depends on ARCH_ARM64
    def_bool y
```
