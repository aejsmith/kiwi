/*
 * SPDX-FileCopyrightText: (C) Alex Smith <alex@alex-smith.me.uk>
 * SPDX-License-Identifier: ISC
 */

/**
 * @file
 * @brief               ARM64 kernel linker script.
 */

#include <arch/aspace.h>
#include <arch/page.h>

ENTRY(kmain)
OUTPUT_ARCH("aarch64")
OUTPUT_FORMAT("elf64-littleaarch64")

PHDRS {
    text PT_LOAD FILEHDR PHDRS FLAGS(5);    /* R_X - Code + read-only data. */
    data PT_LOAD FLAGS(6);                  /* RW_ - Data. */
    init PT_LOAD FLAGS(7);                  /* RWX - Reclaimable init code/data. */
    note PT_NOTE FLAGS(0);
}

SECTIONS {
    /DISCARD/ : {
        *(.note.GNU-stack)
        *(.note.gnu.*)
        *(.comment*)
    }

    . = KERNEL_VIRT_BASE;
    __text_seg_start = .;

    . = . + SIZEOF_HEADERS;
    .text : {
        __text_start = .;
        *(.text)
        *(.text.*)
        . = ALIGN(PAGE_SIZE);
        __text_end = .;
    } :text

    .notes : {
        *(.note.*)
    } :text :note

    . = ALIGN(PAGE_SIZE);
    .rodata : {
        __rodata_start = .;
        *(.rodata)
        *(.rodata.*)
        . = ALIGN(PAGE_SIZE);
        __rodata_end = .;
    } :text

    __text_seg_end = .;

    /* Align the start of each segment to a large page boundary to allow the
     * kernel to be mapped with large pages. */
    . = ALIGN(LARGE_PAGE_SIZE);
    __data_seg_start = .;

    .data : {
        __data_start = .;
        *(.data)
        *(.data.*)
        . = ALIGN(PAGE_SIZE);
        __data_end = .;
    } :data

    . = ALIGN(PAGE_SIZE);
    .bss : {
        __bss_start = .;
        *(.bss)
        *(.bss.*)
        *(COMMON)
        . = ALIGN(PAGE_SIZE);
        __bss_end = .;
    } :data

    __data_seg_end = .;

    . = ALIGN(LARGE_PAGE_SIZE);
    __init_seg_start = .;

    .init.text : { *(.init.text) } :init

    . = ALIGN(PAGE_SIZE);
    .init.data : {
        *(.init.data)

        . = ALIGN(32);
        __initcall_start = .;
        *(.init.initcalls)
        __initcall_end = .;

        . = ALIGN(PAGE_SIZE);
    } :init

    __init_seg_end = .;
    __end = .;
}
